## Documentation/devicetree/bindings/hwmon/keystone-srss.txt
```
Texas Instruments Smart Reflex Sub-System (SRSS) module for Keystone devices

Required properties:
- compatible : Should be "ti,keystone-srss"
- reg : Should contain SRSS registers location and length

Optional properties:
- clocks : the clock feeding the smart reflex sub-system.
	   Needed if platform uses clocks.
	   See clock-bindings.txt
- clocks-names : clock name strings correspond to the clocks
		 defined above. These strings are used inside
		 module source code to identify the respective
                 clocks

Documentation:
http://www.ti.com/lit/ds/symlink/tci6636k2h.pdf

Examples:

srss: srss@2330000 {
        compatible = "ti,keystone-srss";
        reg = <0x02330000 0x800>;
        clocks = <&clksr>;
        clock-names = "srssclock";
};
```

## Documentation/devicetree/bindings/misc/keystone-debugss.txt
```
Texas Instruments Debug Sub-System (DebugSS) module for Keystone devices

Required properties:
- compatible : Should be "ti,keystone-debugss"

Optional properties:
- clocks : the clocks feeding the Debug sub-system.
	   As an exception, the mainpllclk and
	   armpllclk are not directly feeding
	   the debugss, instead they are used
	   by the debugss module to expose the
	   mainpll and armpll clock rates as
	   sysfs entries readable from userspace
	   applications.
	   Needed if platform uses clocks.
	   See clock-bindings.txt
- clocks-names : clock name strings correspond to the clocks
		 defined above. These strings are used inside
		 module source code to identify the respective
                 clocks

Documentation:
http://www.ti.com/lit/ug/spruhm4/spruhm4.pdf
http://www.ti.com/lit/ds/symlink/tci6636k2h.pdf

Examples:

debugss: debugss {
        compatible = "ti,keystone-debugss";
        clocks = <&mainpllclk>, <&armpllclk>, <&clkdebugsstrc>, <&gemtraceclk>, <&clktetbtrc>;
        clock-names = "mainpllclock", "armpllclock", "debugssclock", "gemtraceclock", "tetbclock";
};
```

## Documentation/devicetree/bindings/soc/ti/keystone-crypto.txt
```
Keystone Crypto Driver

This document explains the device tree bindings for the side-band Security
Accelerator on keystone devices.

Required properties:
 - compatible: should be "ti,netcp-sa-crypto".

 - label: must be "crypto-gbe".

 - clock: phandle to clksa clock.

 - reg: Should contain register location and length of the SA hardware
	module.

 - ti,navigator-dmas and ti,navigator-dma-names: Security accelerator uses
	2 dma channels. Rx and Tx. The first property is the pandle to the
	knav_dmas subsystem and flow for RX channel and channel number for
	TX channel. The second property is corresponding channel names.

 - ti,rx-channel: name of RX channel.

 - ti,rx-queue-depth and ti,rx-buffer-size: RX channel may use upto 4 free
	descriptor queue. Those properties describes number of buffers in
	each queue and the buffer's length.

 - ti,rx-compl-queue: RX completion queue number.

 - ti,rx-pool: number of buffer descriptos and region for rx-pool.

 - ti,tx-channel: name of TX channel.

 - ti,tx-queue-depth: number of TX descriptos.

 - ti,tx-completion-queue: TX completion queue number.

 - ti,tx-pool: number of buffer descriptos and region for tx-pool.

 - ti,tx-submit-queue: submition queue number for TX channel.

 - ti,sc-id: range of security contex IDs available for driver


Example:

crypto@20c0000 {
	compatible = "ti,netcp-sa-crypto";
	label = "crypto-gbe";
	reg = <0x20c0000 0x40000>;
	clocks = <&clksa>;

	ti,navigator-dmas = <&dma_gbe 26>, <&dma_gbe 6>;
	ti,navigator-dma-names = "crypto-rx", "crypto-tx";

	ti,rx-channel = "crypto-rx";
	ti,rx-queue-depth = <256 64 0 0>;
	ti,rx-buffer-size = <1500 4096 0 0>;
	ti,rx-compl-queue = <8712>;
	ti,rx-pool	= <512 12>;

	ti,tx-channel = "crypto-tx";
	ti,tx-queue-depth = <256>;
	ti,tx-completion-queue = <8713>;
	ti,tx-pool = <512 12>;
	ti,tx-submit-queue = <646>;

	ti,sc-id = <0x7000 0x71ff>;
};
```
